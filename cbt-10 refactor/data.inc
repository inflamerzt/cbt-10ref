.CSEG
MINI_CIFRA_SP:
.db 1, 1, \
0x00,1

MINI_CIFRA_0:
.db 5, 1, \
0x00,1,0x3E,0x41,0x41,0x3E

MINI_CIFRA_1:
.db 5, 1, \
0x00,1,0x04,0x02,0x7F,0x00,1,0xFF

MINI_CIFRA_2:
.db 5, 1, \
0x00,1,0x62,0x51,0x49,0x46

MINI_CIFRA_3:
.db 5, 1, \
0x00,1,0x22,0x41,0x49,0x36

MINI_CIFRA_4:
.db 5, 1, \
0x00,1,0x18,0x14,0x12,0x7F

MINI_CIFRA_5:
.db 5, 1, \
0x00,1,0x27,0x45,0x45,0x39

MINI_CIFRA_6:
.db 5, 1, \
0x00,1,0x3E,0x49,0x49,0x32

MINI_CIFRA_7:
.db 5, 1, \
0x00,1,0x01,0x61,0x1D,0x03

MINI_CIFRA_8:
.db 5, 1, \
0x00,1,0x36,  0x49,   0x49,0x36

MINI_CIFRA_9:
.db 5, 1, \
0x00,1,0x26,   0x49,0x49,0x3E

ne_CIFRA:
.db	8, 2, \
0x00, 16

MINI_dot:
.db 1,1, \
0x80, 0

MINI_Ddot:
.db 1,1, \
0x24 , 0

CIFRA_0:
.db	8, 2, \
0x00,1, 0xFC, 0xFE, 0x06, 0x06, 0xFE, 0xFC, 0x00, 2, 0x3F, 0x7F, 0x60, 0x60, 0x7F, 0x3F, 0x00,1

CIFRA_1:
.db	8, 2, \
0x00,1, 0x18, 0x1C, 0xFE, 0xFE, 0x00, 4, 0x60, 0x60, 0x7F, 0x7F, 0x60, 0x60, 0x00,1

CIFRA_2:
.db	8, 2, \
0x00,1, 0x06, 0x86, 0x86, 0x86, 0xFE, 0xFC, 0x00, 2, 0x7F, 0x7F, 0x61, 0x61, 0x61, 0x60, 0x00,1

CIFRA_3:
.db	8, 2, \
0x00,1, 0x06, 0x86, 0x86, 0x86, 0xFE, 0x7C, 0x00, 2, 0x60, 0x61, 0x61, 0x61, 0x7F, 0x3E, 0x00,1

CIFRA_4:
.db	8, 2, \
0x00,1, 0xFE, 0xFE, 0x80, 0x80, 0xFE, 0xFE, 0x00, 3, 0x01, 0x01, 0x01, 0x7F, 0x7F, 0x00,1 ,0xFF

CIFRA_5:
.db	8, 2, \
0x00,1, 0xFE, 0xFE, 0x86, 0x86, 0x86, 0x06, 0x00, 2, 0x61, 0x61, 0x61, 0x61, 0x7F, 0x3F, 0x00,1

CIFRA_6:
.db	8, 2, \
0x00,1, 0xFC, 0xFE, 0x86, 0x86, 0x8E, 0x0C, 0x00, 2, 0x3F, 0x7F, 0x61, 0x61, 0x7F, 0x3F, 0x00,1

CIFRA_7:
.db	8, 2, \
0x00,1, 0x06, 0x06, 0x06, 0x06, 0xFE, 0xFE, 0x00, 6, 0x7F, 0x7F, 0x00,1

CIFRA_8:
.db	8, 2, \
0x00,1, 0x7C, 0xFE, 0x86, 0x86, 0xFE, 0x7C, 0x00, 2, 0x3E, 0x7F, 0x61, 0x61, 0x7F, 0x3E, 0x00,1

CIFRA_9:
.db	8, 2, \
0x00,1, 0x7C, 0xFE, 0x86, 0x86, 0xFE, 0xFC, 0x00, 2, 0x30, 0x71, 0x61, 0x61, 0x7F, 0x3F, 0x00,1

DDot:
.db 4,2, \
0x00,1, 0x60,0x60,0x00,2,0x06,0x06,0x00,1

ZAPITAY:
.db	4, 2, \
0x00, 5, 0x60, 0x60, 0x00,1

RAD_BIG: ;possible to cut spaces
.db 96,9, \
0x00,   25, 0x80, 0xC0, 0xE0, 0xF0, 0xF0, 0xE0, 0xC0, 0x00,   30, 0xC0, 0xE0, 0xF0, 0xF0, 0xE0, \
0xC0, 0x80, 0x00,   45, 0xC0, 0xF0, 0xF8, 0xFC, 0xFE, 0xFF, 0xFF, 0xFF, 0xFF, 0xFF, 0xFF, 0xFF, \
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0x00,   75, 0x01, 0x01, 0x01, 0x01, 0x01, 0x01, 0x01, 0x01, 0x01, 0x01, 0x01, 0x00,   43,    0

; all RAD_0..3 must be reduced to 2 lines

RAD_0:
.db 19, 3, \
0x00,   19, 0x60, 0x78, 0x7C, 0x7E, 0x7F, 0x7C, 0xB0, 0xC0, 0xE0, 0xC0, 0xB0, 0x7C, 0x7F, 0x7E, \
0x7C, 0x78, 0x60, 0x00,    7, 0x40, 0x70, 0xFD, 0xFF, 0xFD, 0x70, 0x40, 0x00,    8

RAD_1:
.db 19, 3, \
0x00,    9, 0x80, 0x80, 0x00,    8, 0xE0, 0xF0, 0xE0, 0xE0, 0xC0, 0xC0, 0x80, 0xC0, 0xE0, 0xDF, \
0xBF, 0x3F, 0x1F, 0x1E, 0x0C, 0x08, 0x00,    3, 0x03, 0x07, 0x03, 0x03, 0x01, 0x01, 0x00,    1, \
0x01, 0x03, 0xFD, 0xFE, 0x7E, 0x7C, 0x3C, 0x18, 0x08, 0x00,    4,    0

RAD_2:
.db 19, 3, \
0x00,    7, 0x80, 0x80, 0x80, 0x00,   14, 0x01, 0x87, 0xDF, 0xFF, 0xDF, 0x87, 0x01, 0x00,    7, \
0x03, 0x0F, 0x1F, 0x3F, 0x7F, 0x1F, 0x06, 0x01, 0x03, 0x01, 0x06, 0x1F, 0x7F, 0x3F, 0x1F, 0x0F, \
0x03, 0x00,    3,    0

RAD_3:
.db 19, 3, \
0x00,    6, 0x80, 0x80, 0x00,   12, 0x08, 0x0C, 0x1E, 0x1F, 0x3F, 0xBF, 0xDF, 0xE0, 0xC0, 0x80, \
0xC0, 0xC0, 0xE0, 0xE0, 0xF0, 0xE0, 0x00,    3, 0x08, 0x18, 0x3C, 0x7C, 0x7E, 0xFE, 0xFD, 0x03, \
0x01, 0x00,    1, 0x01, 0x01, 0x03, 0x03, 0x07, 0x03, 0x00,    3,    0


RODGER:
.db 19, 2, \
0x00,   6, 0x3C, 0xE6, 0x66, 0xFE, 0x66, 0xE6, 0x3C, 0x00,   10, 0x22, 0x63, 0x24, 0x15, 0x18, \
0x09, 0x18, 0x15, 0x24, 0x63, 0x22, 0x00,    5



PAUSA:
.db 14, 2, \
0x00,    3, 0xF8, 0x08, 0xF8, 0x00,    1, 0xF8, 0x08, 0xF8, 0x00,    7, 0x1F, 0x10, 0x1F, 0x00, \
   1, 0x1F, 0x10, 0x1F, 0x00,    4

T:
.db 5, 1, \
0x01 , 0x01 , 0x7F , 0x01 , 0x01 , 0

SUMMA:
.db 5, 1, \
0x41 , 0x63 , 0x55 , 0x49 , 0x41 , 0

CPS:
.db 14, 1, \
0x3C , 0x42 , 0x42 , 0x24 , 0x00 , 1 , 0x7E , 0x12 , 0x12 , 0x0C , 0x00 , 1 , 0x24 , 0x4A , 0x52 , 0x24

MkrH: ; 
.db 18, 1, \
0xFC , 0x20 , 0x20 , 0x1C , 0x00 , 1 , 0x3F , 0x09 , 0x09 , 0x36 , 0x00 , 1 , 0x60 , 0x1C , 0x03 , 0x00 , 1 , 0x3F , \
 0x08, 0x04 , 0x38 , 0



Batter_fill:
.db 1,1, \
0xbd,0

Batter_nofill:
.db 1,1, \
0x81, 0

Batter_cap:
.db 2,1, \
0x3C, 0xE7

Batter_bcap:
.db 2,1, \
0x81, 0xFF



;Timer: ; extract double dots and no need at all
;.db 54, 2, \
;0xFC, 0xFE, 0x06, 0x06, 0xFE, 0xFC, 0x00, 2, 0xFC, 0xFE, 0x06, 0x06, 0xFE, 0xFC, 0x00, 2, \
;0x60, 0x60, 0x00, 2, 0xFC, 0xFE, 0x06, 0x06, 0xFE, 0xFC, 0x00, 2, 0xFC, 0xFE, 0x06, 0x06, \
;0xFE, 0xFC, 0x00, 2, 0x60, 0x60, 0x00, 2, 0xFC, 0xFE, 0x06, 0x06, 0xFE, 0xFC, 0x00, 2, \
;0xFC, 0xFE, 0x06, 0x06, 0xFE, 0xFC, 0x3F, 0x7F, 0x60, 0x60, 0x7F, 0x3F, 0x00, 2, 0x3F, 0x7F, \
;0x60, 0x60, 0x7F, 0x3F, 0x00, 2, 0x06, 0x06, 0x00, 2, 0x3F, 0x7F, 0x60, 0x60, 0x7F, 0x3F, \
;0x00, 2, 0x3F, 0x7F, 0x60, 0x60, 0x7F, 0x3F, 0x00, 2, 0x06, 0x06, 0x00, 2, 0x3F, 0x7F, \
;0x60, 0x60, 0x7F, 0x3F, 0x00, 2, 0x3F, 0x7F, 0x60, 0x60, 0x7F, 0x3F



Alfa:
.db 8,2, \
0xC0 , 0xE0 , 0x20 , 0x60 , 0xC0 , 0xE0 , 0x20 , 0x00 , 1 , 0x07 , 0x0F , 0x08 , 0x0C , 0x07 , 0x0F , 0x0C , 0x04, \
0xFF ;padding byte

Beta:
.db 8,2, \
0x00 , 1, 0xF8 , 0xFC , 0x46 , 0x66 , 0xFC , 0xDC , 0x80 , 0x80 , 0xFF , 0x7F , 0x08 , 0x18 , 0x1C , 0x0F , 0x07, \
0xFF ;padding byte

Gamma:
.db 8,2, \
0x60 , 0x30 , 0x70 , 0xE0 , 0x80 , 0xE0 , 0x70 , 0x18 , 0x00 , 3 , 0x7F , 0x3F , 0x01 , 0x00 , 2, \
0xFF ;padding byte

Equal:
.db 4,2, \
0x40 , 0x40 , 0x40 , 0x40 , 0x02 , 0x02 , 0x02 , 0x02


Summa_ravno: ; separate "=" and maybe reduce to 1 line
.db 16, 2, \
0x18, 0x38, 0x78, 0xF8, 0xD8, 0x98, 0x18, 0x38, 0x38, 0x00, 3, 0x80, 0x80, 0x80, \
0x80, 0x30, 0x38, 0x3C, 0x3E, 0x37, 0x33, 0x31, 0x38, 0x38, 0x00, 3, 0x02, 0x02, 0x02, 0x02

Result: ; reduce spaces and maybe reduce to 1 line
.db 33, 2, \
0xF0, 0x20, 0x10, 0x10, 0x00,    1, 0xE0, 0x90, 0x90, 0x90, 0xE0, 0x00,    1, 0x60, \
0x90, 0x90, 0x90, 0x20, 0x00, 1, 0xF0, 0x00, 3, 0xF0, 0x00, 1, 0xF0, 0x00, 4, 0x10, \
0x10, 0xF0, 0x10, 0x10,  0x07, 0x00,   4, 0x03, 0x04, 0x04, 0x04, 0x00,    2, 0x02, \
0x04, 0x04, 0x04, 0x03, 0x00, 1, 0x03, 0x04, 0x04, 0x04, 0x03, 0x00, 1, 0x07, 0x04, 0x04, \
0x04, 0x00, 3, 0x07, 0x00, 2





On:
.db 36, 1, \
0x03 , 0x87 , 0x8C , 0xD8 , 0x70 , 0x38 , 0x1F , 0x07 , 0x00 , 2 , 0xFF , 0xFF , 0xD1 , 0xDF , 0xEE , 0x60, \
0x00,1 , 0xE0 , 0xF8 , 0x1F , 0x0F , 0x78 , 0xC0 , 0x70 , 0x1F , 0x0F , 0xF8 , 0xC0 , 0x00,1 , 0xFF , 0xFF , 0x0C, \
0x0C , 0x3E , 0xF3 , 0xC1

Off:
.db 36, 1, \
0xFF , 0xFF , 0xD1 , 0xDF , 0xEE , 0x60 , 0x00 , 2 , 0xFF , 0xFF , 0x40 , 0x30 , 0x18 , 0x0C , 0xFF , 0xFF, \
0x00,1 , 0xE0 , 0xF8 , 0x0F , 0x0F , 0x78 , 0xC0 , 0x70 , 0x1F , 0x07 , 0xF8 , 0xC0 , 0x00,1, 0xFF , 0xFF , 0x0C, \
0x0C , 0x3E , 0xF3 , 0xC1

Bq_cm2:
.db 25, 1, \
0x3F , 0x25 , 0x25 , 0x1A , 0x00 , 1, 0x18 , 0x24 , 0x24 , 0xFC , 0x00 , 1, 0x60 , 0x1C , 0x03 , 0x18 , 0x24 , 0x24, \
0x00 , 1 , 0x3C , 0x04 , 0x18 , 0x04 , 0x38 , 0x00, 1 , 0x0D , 0x0B, 0

Minus:
.db 6, 2, \
0x80, 0x80, 0x80, 0x80, 0x80, 0x80, 0x01, 0x01, 0x01, 0x01, 0x01, 0x01

Plus:
.db 6, 2, \
0x80, 0x80, 0xE0, 0xE0, 0x80, 0x80, 0x01, 0x01, 0x07, 0x07, 0x01, 0x01



Strelka:
.db 4, 2, \
0x00,1, 0x80, 0xC0, 0xE0, 0x01, 0x03, 0x07, 0x0F, 0xFF


;BAR_PIC

soundOFF:
.db 8,1 , \
0xB8 , 0x48 , 0x64 , 0x92 , 0xFE , 0x04 , 0x02 , 0

soundON:
.db. 8,1, \
0x38 , 0x28 , 0x44 , 0x82 , 0xFE , 0x54 , 0x92 , 0

alarmOFF:
.db. 8,1, \
0x80 , 0x40 , 0x7C , 0x52 , 0xCA , 0x44 , 0x7A , 0x40

alarmON:
.db 8,1, \
0x00 , 1 , 0x40 , 0x7C , 0x42 , 0xC2 , 0x42 , 0x7C , 0x40, 0

volt:
.db 4,1, \
0x00, 1, 0x70 , 0x80 , 0x70 , 0xFF

;PUNKT_MENU

count_menu:
.db 55 , 1, \
0x3C , 0x42 , 0x42 , 0x42 , 0x24 , 0x00, 1 , 0x3C , 0x42 , 0x42 , 0x42 , 0x3C , 0x00,1 , 0x3E , 0x40 , 0x40 , 0x40, \
 0x3E , 0x00, 1 , 0x7E , 0x06 , 0x18 , 0x60 , 0x7E , 0x00, 1 , 0x02 , 0x02 , 0x7E , 0x02 , 0x02 , 0x00 , 1 , 0x7E , 0x42, 0x42, \
 0x42 , 0x3C , 0x00,1 , 0x3C , 0x42 , 0x42 , 0x42 , 0x3C , 0x00, 1 , 0x06 , 0x18 , 0x60 , 0x18 , 0x60 , 0x18, 0x06 , \
 0x00 , 1, 0x7E , 0x06 , 0x18 , 0x60 , 0x7E , 0

alarm_menu:
.db 50,1, \
 0x60 , 0x18 , 0x16 , 0x18 , 0x60 , 0x00 , 1 ,0x7E , 0x40 , 0x40 , 0x00 , 1 , 0x60 , 0x18 , 0x16 , 0x18 , 0x60 , 0x00 , \
 1 , 0x7E , 0x12 , 0x12 , 0x12 , 0x6C , 0x00 , 1 , 0x7E , 0x06 , 0x18 , 0x60 , 0x18 , 0x06 , 0x7E , 0x00 , 21 , 0

threshold_menu:
.db 50,1, \
 0x02 , 0x02 , 0x7E , 0x02 , 0x02 , 0x00 , 1 , 0x7E , 0x08 , 0x08 , 0x7E , 0x00, 1 , 0x7E , 0x12 , 0x12 , 0x12 , 0x6C, \
 0x00, 1 , 0x7E , 0x4A , 0x4A , 0x42 , 0x00, 1 , 0x24 , 0x4A , 0x52 , 0x24 , 0x00, 1 , 0x7E , 0x08 , 0x08 , 0x7E , 0x00, 1, \
 0x3C , 0x42 , 0x42 , 0x42 , 0x3C , 0x00, 1 , 0x7E , 0x40 , 0x40 , 0x00, 1 , 0x7E , 0x42 , 0x42 , 0x42 , 0x3C , 0x00, 3 , 0
 

volume_menu:
.db 57,1, \
 0x3C , 0x42 , 0x42 , 0x42 , 0x24 , 0x00 , 1 , 0x7E , 0x40 , 0x40 , 0x00 , 1 , 0x7E , 0x00 , 1 , 0x3C , 0x42 , 0x42 , \
 0x42 , 0x24 , 0x00 , 1 , 0x7E , 0x18 , 0x24 , 0x42 , 0x00 , 3 , 0x06 , 0x18 , 0x60 , 0x18 , 0x06 , 0x00 , 1 , 0x3C, \
 0x42 , 0x42 , 0x42 , 0x3C , 0x00 , 1 , 0x7E , 0x40 , 0x40 , 0x00 , 1 , 0x3E , 0x40 , 0x40 , 0x40 , 0x3E , 0x00 , 1 , \
 0x7E, 0x08 , 0x30 , 0x08 , 0x7E , 0x00 , 1 , 0x7E , 0x4A , 0x4A , 0x42, 0

bright_menu:
.db 51,1, \
 0x7E , 0x4A , 0x4A , 0x4A , 0x34 , 0x00 , 1 , 0x7E , 0x12 , 0x12 , 0x12 , 0x6C , 0x00 , 1 , 0x7E , 0x00 , 1 , 0x3C  , \
 0x42 , 0x42 , 0x52 , 0x74 , 0x00 , 1 , 0x7E , 0x08 , 0x08 , 0x7E , 0x00 , 1 , 0x02 , 0x02 , 0x7E , 0x02 , 0x02 , 0x00 , 1 , 0x7E, \
 0x06 , 0x18 , 0x60 , 0x7E , 0x00 , 1 , 0x7E , 0x4A , 0x4A , 0x42 , 0x00 , 1 , 0x24 , 0x4A , 0x52 , 0x24 , 0x00 , 1 , 0x24 , 0x4A, \
 0x52 , 0x24

senset_menu:
.db 51,1, \
 0x24 , 0x4A , 0x52 , 0x24 , 0x00 , 1 , 0x7E , 0x4A , 0x4A , 0x42 , 0x00 , 1 , 0x7E , 0x06 , 0x18 , 0x60 , 0x7E , 0x00, \
 1 , 0x24 , 0x4A , 0x52 , 0x24 , 0x00 , 1 , 0x3C , 0x42 , 0x42 , 0x42 , 0x3C , 0x00 , 1 , 0x7E , 0x12 , 0x12 , 0x12 , \
 0x6C , 0x00 , 3 , 0x24 , 0x4A , 0x52 , 0x24 , 0x00 , 1 , 0x7E , 0x4A , 0x4A , 0x42 , 0x00 , 1 , 0x02 , 0x02 , 0x7E, \
 0x02 , 0x02 , 0x40 , 0

batcal_menu:
.db 52,1, \
 0x7E , 0x4A , 0x4A , 0x4A , 0x34 , 0x00 , 1 , 0x60 , 0x18 , 0x16 , 0x18 , 0x60 , 0x02 , 0x02 , 0x7E , 0x02  , \
 0x02 , 0x00 , 1 , 0x40 , 0x00 , 3 , 0x3C , 0x42 , 0x42 , 0x42 , 0x24 , 0x00 , 1 , 0x60 , 0x18 , 0x16 , 0x18 , 0x60, \
 0x00 , 1 , 0x7E , 0x40 , 0x40 , 0x00 , 1 , 0x7E , 0x00 , 1 , 0x7E , 0x4A , 0x4A , 0x4A , 0x34 , 0x00 , 1 , 0x7E , 0x12 , 0x12, \
 0x12 , 0x6C , 0x00 , 1 , 0x40, 0

contrast_menu:
.db 45,1, \
 0x3C , 0x42 , 0x42 , 0x42 , 0x24 , 0x00 , 1 , 0x3C , 0x42 , 0x42 , 0x42 , 0x3C , 0x00 , 1 , 0x7E , 0x06 , 0x18 , 0x60, \
 0x7E , 0x00 , 1 , 0x02 , 0x02 , 0x7E , 0x02 , 0x02 , 0x00 , 1 , 0x7E , 0x12 , 0x12 , 0x12 , 0x6C , 0x00 , 1 , 0x60  , \
 0x18 , 0x16 , 0x18 , 0x60 , 0x00 , 1 , 0x24 , 0x4A , 0x52 , 0x24 , 0x02 , 0x02 , 0x7E , 0x02 , 0x02, 0



 ;PIC_MENU

 count_pic:
.db 28,4, \
 0xC0 , 0xE0 , 0xF0 , 0x78 , 0x3C , 0x9E , 0xCC , 0xC8 , 0xE0 , 0xE0 , 0xE0 , 0xF0 , 0x70 , 0x70 , 0x70 , 0x70, \
 0xF0 , 0xE0 , 0xE0 , 0xE0 , 0xC8 , 0x8C , 0x9E , 0x3C , 0x78 , 0xF0 , 0xE0 , 0xC0 , 0x80 , 0xF1 , 0xF8 , 0x7E, \
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 0x70 , 0x70 , 0x70 , 0x70 , 0x38 , 0x38 , 0x3C , 0x1C , 0x1E , 0x0F , 0x07 , 0x03 , 0x01 , 0x00 , 2 , 0

 alarm_pic:
.db 31,4, \
 0x00 , 3 , 0x80 , 0xC0 , 0x40 , 0x00 , 1 , 0x80 , 0x00 , 2 , 0x80 , 0xC0 , 0xC0 , 0x60 , 0x60 , 0x60, \
 0x60 , 0x60 , 0xC0 , 0xC0 , 0x80 , 0x00 , 2 , 0x80 , 0x00 , 1 , 0x40 , 0xC0 , 0x80 , 0x00 , 3 , 0xE0, \
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 0x01 , 0x01 , 0x01 , 0x01 , 0x01 , 0x01 , 0x01 , 0x00 , 5 , 0


 threshold_pic:
.db 28,4, \
 0x00 , 7 , 0xF0 , 0xF8 , 0xFC , 0xFC , 0xFE , 0xFE , 0xFE , 0xFE, \
 0xFE , 0xFE , 0xFC , 0xFC , 0xF8 , 0xF0 , 0x00 , 8 , 0x80 , 0x80, \
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 0x01 , 0x00 , 2 , 0x01 , 0x01 , 0x03 , 0x03 , 0x07 , 0x06 , 0x06 , 0x0E , 0x0C , 0x3C , 0x3E , 0x3E , 0x0C

 clk_vol_pic:
.db 27,4, \
 0x00 , 10 , 0x80 , 0xC0 , 0xE0 , 0x70 , 0xF8 , 0xF8, \
 0x00 , 5 , 0xC0 , 0xC0 , 0x80 , 0x00 , 3 , 0xFC , 0xFC , 0x0C , 0x0C , 0x0C, \
 0x0C , 0x0C , 0xFC , 0xFE , 0x07 , 0x03 , 0x01 , 0x00 , 2 , 0xFF , 0xFF , 0x00 , 2 , 0x0C , 0x1C , 0xF8, \
 0xE0 , 0x01 , 0x03 , 0x0F , 0xFC , 0xF0 , 0x3F , 0x3F , 0x30 , 0x30 , 0x30 , 0x30 , 0x30 , 0x3F , 0x7F , 0xE0, \
 0xC0 , 0x80 , 0x00 , 2 , 0xFF , 0xFF , 0x00 , 2 , 0x60 , 0x70 , 0x3F , 0x0F , 0x00 , 1, 0x80 , 0xE0 , 0x7F, 0x1F ,\
 0x00 ,  10 , 0x01 , 0x03 , 0x07 , 0x0E , 0x1F, 0x1F , 0x00 , 5 , 0x06 , 0x07 , 0x03 , 0x01 , 0x00 , 2 

 bright_pic:
.db 31,4 , \
 0x00 , 4 , 0x30 , 0x70 , 0xE0 , 0xC0 , 0x80 , 0x00 , 6 , 0x3F, \
 0x3F , 0x00 , 5 , 0x80 , 0xC0 , 0xE0 , 0x70 , 0x30 , 0x00 , 4 , 0xC0, \
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 0x06 , 0x07 , 0x03 , 0x01 , 0x00 , 6 , 0x7E , 0x7E , 0x00 , 7 , 0x01 , 0x03 , 0x07 , 0x06 , 0x00 , 4

 sen_set_pic:
.db 30,4, \
 0x00 , 3 , 0x80 , 0x40 , 0x20 , 0x10 , 0x08 , 0x08 , 0x34 , 0xF4 , 0xF2 , 0xFA , 0xFA , 0xFA , 0xFA, 0xFA , \
 0xFA , 0xF2 , 0xF4 , 0x34 , 0x08 , 0x08 , 0x10 , 0x20 , 0x40 , 0x80 , 0x00 , 3 , 0xE0 , 0x1C, \
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 0x09 , 0x04 , 0x02 , 0x01 , 0x00 , 3 


 bat_cal_pic:
.db 20,4, \
 0xC0 , 0xE0 , 0x70 , 0x30 , 0x30 , 0x3E , 0x3E , 0x26 , 0x26 , 0x26 , 0x26 , 0x26 , 0x26 , 0x3E , 0x3E , 0x30, \
 0x30 , 0x70 , 0xE0 , 0xC0 , 0xFF , 0xFF , 0x00 , 2 , 0xCE , 0xCE , 0xCE , 0xCE , 0xCE , 0xCE , 0xCE , 0xCE, \
 0xCE , 0xCE , 0xCE , 0xCE , 0x00 , 2 , 0xFF , 0xFF , 0xFF , 0xFF , 0x00 , 2 , 0x39 , 0x39 , 0x39 , 0x39, \
 0x39 , 0x39 , 0x39 , 0x39 , 0x39 , 0x39 , 0x39 , 0x39 , 0x00 , 2 , 0xFF , 0xFF , 0x1F , 0x3F , 0x70 , 0x60, \
 0x67 , 0x67 , 0x67 , 0x67 , 0x67 , 0x67 , 0x67 , 0x67 , 0x67 , 0x67 , 0x67 , 0x67 , 0x60 , 0x70 , 0x3F , 0x1F

 contr_pic:
.db 31,4, \
 0x00 , 4 , 0x30 , 0x70 , 0xE0 , 0xC0 , 0x80 , 0x00 , 6 , 0x3F , 0x3F , 0x00 , 5 , 0x80 , 0xC0 , 0xE0 , 0x70 , 0x30 , 0x00 , 4 , 0xC0, \
 0xC0 , 0xC0 , 0xC0 , 0xC0 , 0xC0 , 0x00 , 1, 0x01 , 0xE1 , 0xF8 , 0xFC , 0xFE , 0xFF , 0xFF , 0xFF , 0x03 , 0x03, \
 0x03 , 0x06 , 0x0E , 0x1C , 0xF8 , 0xE1 , 0x01 , 0x00 , 1, 0x80 , 0x80 , 0x80 , 0x80 , 0x80 , 0x80 , 0x00 , 6, \
 0x80 , 0xC0 , 0xC3 , 0x0F , 0x1F , 0x3F , 0x3F , 0x7F , 0x7F , 0x60 , 0x60 , 0x60, \
 0x30 , 0x38 , 0x1C , 0x0F , 0xC3 , 0xC0 , 0x80 , 0x01 , 0x01 , 0x01 , 0x01 , 0x01 , 0x01 , 0x00 , 4, \
 0x06 , 0x07 , 0x03 , 0x01 , 0x00 , 6 , 0x7E , 0x7E , 0x00 , 7 , 0x01 , 0x03 , 0x07 , 0x06 , 0x00 ,4