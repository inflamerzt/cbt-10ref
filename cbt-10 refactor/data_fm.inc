.CSEG

;------------------------------------------------------------------------------

;---------------- 1 line digits 
SD0: ;0
.db 5, 1
.db 0x00,0x7C,0x82,0x82,0x7C,0x00

SD1: ;1
.db 5, 1
.db 0x00,0x08,0x04,0xFE,0x00,0x00

SD2: ;2
.db 5, 1
.db 0x00,0xC4,0xA2,0x92,0x8C,0x00

SD3: ;3
.db 5, 1
.db 0x00,0x44,0x82,0x92,0x6C,0x00

SD4: ;4
.db 5, 1
.db 0x00,0x30,0x28,0x24,0xFE,0x00

SD5: ;5
.db 5, 1
.db 0x00,0x4E,0x8A,0x8A,0x72,0x00

SD6: ;6
.db 5, 1
.db 0x00,0x7C,0x92,0x92,0x64,0x00

SD7: ;7
.db 5, 1
.db 0x00,0x02,0xC2,0x3A,0x06,0x00

SD8: ;8
.db 5, 1
.db 0x00,0x6C,0x92,0x92,0x6C,0x00

SD9: ;9
.db 5, 1
.db 0x00,0x4C,0x92,0x92,0x7C,0x00

;ne_CIFRA:
;.db	8, 2
;.db 0x00, 0x00, 0x00, 0x00, 0x00, 0x00, 0x00, 0x00, 0x00, 0x00, 0x00, 0x00, 0x00, 0x00, 0x00, 0x00

;------- 2 line digits ------------------------
MD0: ;0 
.db	8, 2
.db 0x00, 0xFC, 0xFE, 0x06, 0x06, 0xFE, 0xFC, 0x00, 0x00, 0x3F, 0x7F, 0x60, 0x60, 0x7F, 0x3F, 0x00

MD1: ;1
.db	8, 2
.db 0x00, 0x18, 0x1C, 0xFE, 0xFE, 0x00, 0x00, 0x00, 0x00, 0x60, 0x60, 0x7F, 0x7F, 0x60, 0x60, 0x00

MD2: ;2
.db	8, 2
.db 0x00, 0x06, 0x86, 0x86, 0x86, 0xFE, 0xFC, 0x00, 0x00, 0x7F, 0x7F, 0x61, 0x61, 0x61, 0x60, 0x00

MD3: ;3
.db	8, 2
.db 0x00, 0x06, 0x86, 0x86, 0x86, 0xFE, 0x7C, 0x00, 0x00, 0x60, 0x61, 0x61, 0x61, 0x7F, 0x3E, 0x00

MD4: ;4
.db	8, 2
.db 0x00, 0xFE, 0xFE, 0x80, 0x80, 0xFE, 0xFE, 0x00, 0x00, 0x00, 0x01, 0x01, 0x01, 0x7F, 0x7F, 0x00

MD5: ;5
.db	8, 2
.db 0x00, 0xFE, 0xFE, 0x86, 0x86, 0x86, 0x06, 0x00, 0x00, 0x61, 0x61, 0x61, 0x61, 0x7F, 0x3F, 0x00

MD6: ;6
.db	8, 2
.db 0x00, 0xFC, 0xFE, 0x86, 0x86, 0x8E, 0x0C, 0x00, 0x00, 0x3F, 0x7F, 0x61, 0x61, 0x7F, 0x3F, 0x00

MD7: ;7
.db	8, 2
.db 0x00, 0x06, 0x06, 0x06, 0x06, 0xFE, 0xFE, 0x00, 0x00, 0x00, 0x00, 0x00, 0x00, 0x7F, 0x7F, 0x00

MD8: ;8
.db	8, 2
.db 0x00, 0x7C, 0xFE, 0x86, 0x86, 0xFE, 0x7C, 0x00, 0x00, 0x3E, 0x7F, 0x61, 0x61, 0x7F, 0x3E, 0x00

MD9: ;9
.db	8, 2
.db 0x00, 0x7C, 0xFE, 0x86, 0x86, 0xFE, 0xFC, 0x00, 0x00, 0x30, 0x71, 0x61, 0x61, 0x7F, 0x3F, 0x00

COMA: ;","
.db	2, 2
.db 0x00, 0x00, 0x60, 0x60

RAD_BIG:
.db 96,8
.db 0x00, 12, 0x80, 0xC0, 0xE0, 0xF0, 0xF0, 0xE0, 0xC0, 0x00,   30, 0xC0, 0xE0, 0xF0, 0xF0, 0xE0
.db 0xC0, 0x80, 0x00,   45, 0xC0, 0xF0, 0xF8, 0xFC, 0xFE, 0xFF, 0xFF, 0xFF, 0xFF, 0xFF, 0xFF, 0xFF
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.db 0x00,   75, 0x01, 0x01, 0x01, 0x01, 0x01, 0x01, 0x01, 0x01, 0x01, 0x01, 0x01, 0x00,   43,    0

RAD_0:
.db 19, 2
.db 0x60, 0x78, 0x7C, 0x7E, 0x7F, 0x7C, 0xB0, 0xC0, 0xE0, 0xC0, 0xB0, 0x7C, 0x7F, 0x7E
.db 0x7C, 0x78, 0x60, 0x00,    7, 0x40, 0x70, 0xFD, 0xFF, 0xFD, 0x70, 0x40,0x00,8,0xFF,0xFF

.db 0xFF,0xFF,0xFF,0xFF,0xFF,0xFF,0xFF,0xFF,0xFF,0xFF,0xFF,0xFF,0xFF,0xFF,0xFF,0xFF,0xFF,0xFF

RAD_1:
.db 19, 2
.db 0xE0, 0xF0, 0xE0, 0xE0, 0xC0, 0xC0, 0x80, 0xC0, 0xE0, 0xDF
.db 0xBF, 0x3F, 0x1F, 0x1E, 0x0C, 0x08, 0x00,    3
 
.db 0x03, 0x07, 0x03, 0x03, 0x01, 0x01, 0x00,    1
.db 0x01, 0x03, 0xFD, 0xFE, 0x7E, 0x7C, 0x3C, 0x18, 0x08, 0x00,    4,    0

RAD_2:
.db 19, 3
.db 0x00,    7, 0x80, 0x80, 0x80, 0x01, 0x87, 0xDF, 0xFF, 0xDF, 0x87, 0x01, 0x00,    7
.db 0x03, 0x0F, 0x1F, 0x3F, 0x7F, 0x1F, 0x06, 0x01, 0x03, 0x01, 0x06, 0x1F, 0x7F, 0x3F, 0x1F, 0x0F
.db 0x03, 0x00,    3,    0

RAD_3:
.db 19, 3
.db 0x00,    6, 0x80, 0x80, 0x00,   12, 0x08, 0x0C, 0x1E, 0x1F, 0x3F, 0xBF, 0xDF, 0xE0, 0xC0, 0x80
.db 0xC0, 0xC0, 0xE0, 0xE0, 0xF0, 0xE0, 0x00,    3, 0x08, 0x18, 0x3C, 0x7C, 0x7E, 0xFE, 0xFD, 0x03
.db 0x01, 0x00,    1, 0x01, 0x01, 0x03, 0x03, 0x07, 0x03, 0x00,    3,    0

RODGER:
.db 19, 2
.db 0x00,   6, 0x3C, 0xE6, 0x66, 0xFE, 0x66, 0xE6, 0x3C, 0x00,   10, 0x22, 0x63, 0x24, 0x15, 0x18
.db 0x09, 0x18, 0x15, 0x24, 0x63, 0x22, 0x00,    5

RODGER_inv:
.db 19, 2
.db 0xFF, 0xFF, 0xFF, 0xFF, 0xFF, 0xFF, 0xC3, 0x19, 0x99, 0x01, 0x99, 0x19, 0xC3, 0xFF
.db 0xFF, 0xFF, 0xFF, 0xFF, 0xFF, 0xFF, 0xFF, 0xFF, 0xFF, 0xDD, 0x9C, 0xDB, 0xEA, 0xE7, 0xF6, 0xE7
.db 0xEA, 0xDB, 0x9C, 0xDD, 0xFF, 0xFF, 0xFF, 0xFF, 0x00,    1

PAUSA:
.db 14, 2
.db 0x00,    3, 0xF8, 0x08, 0xF8, 0x00,    1, 0xF8, 0x08, 0xF8, 0x00,    7, 0x1F, 0x10, 0x1F, 0x00
.db    1, 0x1F, 0x10, 0x1F, 0x00,    4

PLAV:
.db 12, 2
.db 0x00,    1, 0x40, 0x20, 0x10, 0x10, 0x20, 0x40, 0x80, 0x80, 0x40, 0x20, 0x00,  2, 0x04, 0x02
.db 0x01, 0x01, 0x02, 0x04, 0x08, 0x08, 0x04, 0x02, 0x00, 1

SUMMA:
.db 14, 2
.db 0x00,    2, 0x10, 0x30, 0x50, 0x90, 0x10, 0x10, 0x10, 0x10, 0x10, 0x30, 0x00,    4, 0x40, 0x60
.db 0x50, 0x48, 0x45, 0x42, 0x40, 0x40, 0x40, 0x60, 0x00,    2

;-----------CPS:
.db 14, 1
.db 0x3E, 0x41, 0x41, 0x22, 0x00, 0x7F, 0x09, 0x09, 0x06, 0x00, 0x26, 0x49, 0x49, 0x32

MkrH:
.db 20, 2
.db 0x00, 0x00, 0xfc, 0x40, 0x40, 0x3c, 0x00, 0x7f, 0x09, 0x09, 0x76, 0x00, 0x60, 0x1c, 0x03, 0x00 
.db 0x7f, 0x08, 0x04, 0x78, 0x00, 0x00, 0x01, 0x00, 0x00, 0x00, 0x00, 0x00, 0x00, 0x00, 0x00, 0x00 
.db 0x00, 0x00, 0x00, 0x00, 0x00, 0x00, 0x00, 0x00

Batter:
.db 23, 2
.db 0x3C, 0xE7, 0x81, 0x81, 0x81, 0x81, 0x81, 0x81, 0x81, 0x81, 0x81, 0x81, 0x81, 0x81, 0x81, 0x81
.db 0x81, 0x81, 0x81, 0x81, 0x81, 0x81, 0xFF, 0x00, 0x7C, 0x82, 0x82, 0x7C, 0x00, 0x80, 0x00, 0x7C
.db 0x82, 0x82, 0x7C, 0x00, 0x7C, 0x82, 0x82, 0x7C, 0x00, 0x0C, 0x30, 0xC0, 0x30, 0x0C, 0x00, 0x00

Timer:
.db 54, 2
.db 0xFC, 0xFE, 0x06, 0x06, 0xFE, 0xFC, 0x00, 0x00, 0xFC, 0xFE, 0x06, 0x06, 0xFE, 0xFC, 0x00, 0x00
.db 0x60, 0x60, 0x00, 0x00, 0xFC, 0xFE, 0x06, 0x06, 0xFE, 0xFC, 0x00, 0x00, 0xFC, 0xFE, 0x06, 0x06
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.db 0x60, 0x60, 0x7F, 0x3F, 0x00, 0x00, 0x3F, 0x7F, 0x60, 0x60, 0x7F, 0x3F

Alfa:
.db 16, 2
.db 0xC0, 0xE0, 0x20, 0x60, 0xC0, 0xE0, 0x20, 0x00, 0x00, 0x00, 0x00, 0x00, 0x80, 0x80, 0x80, 0x80
.db 0x07, 0x0F, 0x08, 0x0C, 0x07, 0x0F, 0x0C, 0x04, 0x00, 0x00, 0x00, 0x00, 0x02, 0x02, 0x02, 0x02

Beta:
.db 16, 2
.db 0x00, 0xF8, 0xFC, 0x46, 0x66, 0xFC, 0xFC, 0x00, 0x00, 0x00, 0x00, 0x00, 0x80, 0x80, 0x80, 0x80
.db 0x00, 0xFF, 0x7F, 0x08, 0x18, 0x0C, 0x0F, 0x03, 0x00, 0x00, 0x00, 0x00, 0x02, 0x02, 0x02, 0x02

Gamma:
.db 16, 2
.db 0x60, 0x30, 0x70, 0xE0, 0x80, 0xE0, 0x70, 0x00, 0x00, 0x00, 0x00, 0x00, 0x80, 0x80, 0x80, 0x80
.db 0x00, 0x00, 0x00, 0x7F, 0x3F, 0x01, 0x00, 0x00, 0x00, 0x00, 0x00, 0x00, 0x02, 0x02, 0x02, 0x02

Summa_ravno:
.db 16, 2
.db 0x18, 0x38, 0x78, 0xF8, 0xD8, 0x98, 0x18, 0x38, 0x38, 0x00, 0x00, 0x00, 0x80, 0x80, 0x80, 0x80
.db 0x30, 0x38, 0x3C, 0x3E, 0x37, 0x33, 0x31, 0x38, 0x38, 0x00, 0x00, 0x00, 0x02, 0x02, 0x02, 0x02

Result:
.db 73, 2
.db 0x00,   18, 0xF0, 0x20, 0x10, 0x10, 0x00,    1, 0xE0, 0x90, 0x90, 0x90, 0xE0, 0x00,    1, 0x60
.db 0x90, 0x90, 0x90, 0x20, 0x00,    1, 0xF0, 0x00,    3, 0xF0, 0x00,    1, 0xF0, 0x00,    4, 0x10
.db 0x10, 0xF0, 0x10, 0x10, 0x00,   40, 0x07, 0x00,    4, 0x03, 0x04, 0x04, 0x04, 0x00,    2, 0x02
.db 0x04, 0x04, 0x04, 0x03, 0x00,    1, 0x03, 0x04, 0x04, 0x04, 0x03, 0x00,    1, 0x07, 0x04, 0x04
.db 0x04, 0x00,    3, 0x07, 0x00,   24

RC:
.db 96, 9
.db 0x00 ,   230, 0xFF , 0xFF , 0x83 , 0x83 , 0x86 , 0xCE , 0x7C , 0x38 , 0x00 ,    2 , 0xE0 , 0xF8 , 0x1C , 0x06 
.db 0x03 , 0x03 , 0x07 , 0x07 , 0x00 ,   78 , 0x0F , 0x0F , 0x01 , 0x01 , 0x03 , 0x03 , 0x06 , 0x0C , 0x0C , 0x00 
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.db 0x03 , 0x03 , 0x01 , 0x00 ,    3 , 0x7F , 0x7F , 0x03 , 0x03 , 0x03 , 0x01 , 0x00 ,   107, 0

Grom_Shek:
.db 96, 8
.db 0x00,   44, 0x80, 0xC0, 0xE0, 0xF0, 0xF0, 0x00,    5, 0x80, 0x80, 0x00,   73, 0xF8, 0xF8, 0x18
.db 0x18, 0x18, 0x18, 0x18, 0xF8, 0xFC, 0x0E, 0x07, 0x03, 0x01, 0x00,    1, 0xFF, 0xFF, 0x00,    2
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.db 0xFF , 0xFF , 0xD8 , 0xD8 , 0xD8 , 0xF8 , 0x70 , 0x00 ,    42, 0x18 , 0x1E , 0x07 , 0x01 , 0x00 ,    167, 0x00

Zvuk_Opov:
.db 59, 2
.db 0x06 , 0x06 , 0xFE , 0xFE , 0x06 , 0x06 , 0x00 , 0x00 , 0xFF , 0xFF , 0x84 , 0x86 , 0x86 , 0xFE , 0x7C , 0x00
.db 0x00 , 0xFE , 0xFE , 0x80 , 0x60 , 0x30 , 0x18 , 0xFE , 0xFE , 0x00 , 0x00 , 0xFE , 0xFE , 0xA2 , 0xBE , 0xDC
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.db 0x01 , 0x01 , 0x01 , 0x00 , 0x01 , 0x01 


Fon_Porog:
.db 96, 8
.db 0x00,   38, 0xE0, 0xE0, 0xE0, 0xE0, 0xE0, 0xE0, 0x60, 0x20, 0x20, 0x20, 0x20, 0x20, 0x60, 0xE0
.db 0xE0, 0xE0, 0xE0, 0xE0, 0xE0, 0x00,   77, 0xFF, 0xFF, 0xFF, 0xFF, 0xBF, 0x9F, 0x78, 0x43, 0xF3
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.db 0x40 , 0x30 , 0x18 , 0x0C , 0xFF , 0xFF , 0x00 ,    44, 0x0F , 0x0F , 0x00 ,    69 

Podsvetka:
.db 96, 8
.db 0x00 ,   35 , 0x30 , 0x70 , 0xE0 , 0xC0 , 0x80 , 0x00,      7, 0x7F , 0x7F , 0x00 ,    6 , 0x80 , 0xC0 , 0xE0 
.db 0x70 , 0x30 , 0x00 ,   67 , 0x80 , 0x80 , 0x80 , 0x80 , 0x80 , 0x80 , 0x80 , 0x01 , 0x03 , 0xC3 , 0xF0 , 0x38 
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.db 0x0F , 0x0C , 0x00 ,    1 , 0x07 , 0x0F , 0x0C , 0x0C , 0x0C , 0x07 , 0x0F , 0x08 , 0x00 ,    20,  0x00 , 0

Vkl:
.db 36, 1
.db 0x03 , 0x87 , 0x8C , 0xD8 , 0x70 , 0x38 , 0x1F , 0x07 , 0x00 , 0x00 , 0xFF , 0xFF , 0xD1 , 0xDF , 0xEE , 0x60
.db 0x00 , 0xE0 , 0xF8 , 0x1F , 0x0F , 0x78 , 0xC0 , 0x70 , 0x1F , 0x0F , 0xF8 , 0xC0 , 0x00 , 0xFF , 0xFF , 0x0C
.db 0x0C , 0x3E , 0xF3 , 0xC1

Vblkl:
.db 36, 1
.db 0xFF , 0xFF , 0xD1 , 0xDF , 0xEE , 0x60 , 0x00 , 0x00 , 0xFF , 0xFF , 0x40 , 0x30 , 0x18 , 0x0C , 0xFF , 0xFF
.db 0x00 , 0xE0 , 0xF8 , 0x0F , 0x0F , 0x78 , 0xC0 , 0x70 , 0x1F , 0x07 , 0xF8 , 0xC0 , 0x00 , 0xFF , 0xFF , 0x0C
.db 0x0C , 0x3E , 0xF3 , 0xC1

Mkr:
.db 18, 2
.db 0xfc, 0x40, 0x40, 0x3c, 0x00, 0x7f, 0x09, 0x09, 0x76, 0x00, 0x60, 0x1c, 0x03, 0x00, 0x7f, 0x08
.db 0x04, 0x78, 0x01, 0x00, 0x00, 0x00, 0x00, 0x00, 0x00, 0x00, 0x00, 0x00, 0x00, 0x00, 0x00, 0x00 
.db 0x00, 0x00, 0x00, 0x00

Minus:
.db 6, 2
.db 0x80, 0x80, 0x80, 0x80, 0x80, 0x80, 0x01, 0x01, 0x01, 0x01, 0x01, 0x01

Plus:
.db 6, 2
.db 0x80, 0x80, 0xE0, 0xE0, 0x80, 0x80, 0x01, 0x01, 0x07, 0x07, 0x01, 0x01

Nastroiki_datchika:
.db 96, 4
.db 0xFF , 0xFF , 0x18 , 0x18 , 0x18 , 0xFF , 0xFF , 0x00 , 0x7C , 0xFE , 0xC7 , 0xC3 , 0xC3 , 0x7F , 0xFF , 0x00
.db 0xC0 , 0xFF , 0x7F , 0x03 , 0x03 , 0x03 , 0xFF , 0xFF , 0x00 , 0x7C , 0xFE , 0xC7 , 0xC3 , 0xC3 , 0x7F , 0xFF
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.db 0x00 , 0x00 , 0x00 , 0x00 , 0x00 , 0x00 , 0x00 , 0x00 , 0x00 , 0x00 , 0x00 , 0x00 , 0x00 , 0x00 , 0x00 , 0x00

Strelka:
.db 4, 2
.db 0x00, 0x80, 0xC0, 0xE0, 0x01, 0x03, 0x07, 0x0F