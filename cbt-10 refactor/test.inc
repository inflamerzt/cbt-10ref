;LCD_dat RAD_1

;LCD_dat SD0 ;0

;LCD_dat SD1 ;1

;LCD_dat SD2 ;2

;LCD_dat SD3 ;3

;LCD_dat SD4 ;4

;LCD_dat SD5 ;5

;LCD_dat SD6 ;6

;LCD_dat SD7 ;7

;LCD_dat SD8 ;8

;LCD_dat SD9 ;9

;------- 2 line digits ------------------------
LCD_dat MD0

;LCD_dat MD1 ;1

;LCD_dat MD2 ;2

;LCD_dat MD3 ;3

;LCD_dat MD4 ;4

;LCD_dat MD5 ;5

;LCD_dat MD6 ;6

;LCD_dat MD7 ;7

;LCD_dat MD8 ;8

;LCD_dat MD9 ;9

;LCD_dat COMA ;","

;LCD_dat RAD_BIG

;LCD_dat RAD_0

;LCD_dat RAD_1

;LCD_dat RAD_2

;LCD_dat RAD_3

;LCD_dat RODGER

;LCD_dat RODGER_inv

;LCD_dat PAUSA

;LCD_dat PLAV

;LCD_dat SUMMA

;LCD_dat CPS

;LCD_dat MkrH

;LCD_dat Batter

;LCD_dat Timer

;LCD_dat Alfa

;LCD_dat Beta

;LCD_dat Gamma

;LCD_dat Summa_ravno

;LCD_dat Result

;LCD_dat RC

;LCD_dat Grom_Shek

;LCD_dat Zvuk_Opov

;LCD_dat Fon_Porog

;LCD_dat Podsvetka

;LCD_dat Vkl

;LCD_dat Vblkl

;LCD_dat Mkr

;LCD_dat Minus

;LCD_dat Plus

;LCD_dat Nastroiki_datchika;

;LCD_dat Strelka
